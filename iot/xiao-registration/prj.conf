## CMakeLists.txt
```
cmake_minimum_required(VERSION 3.20.0)
find_package(Zephyr 4.2.0 REQUIRED HINTS $ENV{ZEPHYR_BASE})
project(tingle_registration C)
target_include_directories(app PRIVATE include vendor/monocypher)
target_sources(app PRIVATE src/main.c src/nus.c src/board.c src/proof.c src/hash.c src/json.c src/request.c src/frame.c
  vendor/monocypher/monocypher.c vendor/monocypher/monocypher-ed25519.c)
target_compile_options(app PRIVATE -Wall -Wextra -Werror -fstack-usage)
```

## west.yml
```
manifest:
  remotes:
    - name: zephyrproject
      url-base: https://github.com/zephyrproject-rtos
  projects:
    - name: zephyr
      remote: zephyrproject
      revision: v4.2.0
      import:
        name-allowlist:
          - cmsis
          - cmsis_6
          - hal_nordic
          - segger
          - tinycrypt
          - mbedtls
  self:
    path: xiao-registration
```

## prj.conf
```kconfig
CONFIG_BT=y
CONFIG_BT_PERIPHERAL=y
CONFIG_BT_DEVICE_NAME="Tingle-Keyring"
CONFIG_BT_MAX_CONN=1
CONFIG_BT_SMP=y
CONFIG_BT_SETTINGS=y
CONFIG_SETTINGS=y
CONFIG_BT_RX_STACK_SIZE=4096
CONFIG_BT_LONG_WQ_STACK_SIZE=4096
CONFIG_SYSTEM_WORKQUEUE_STACK_SIZE=4096
CONFIG_MAIN_STACK_SIZE=12288
CONFIG_HEAP_MEM_POOL_SIZE=8192
CONFIG_COMMON_LIBC_MALLOC_ARENA_SIZE=16384
CONFIG_FLASH=y
CONFIG_FLASH_MAP=y
CONFIG_FLASH_PAGE_LAYOUT=y
CONFIG_NORDIC_QSPI_NOR_FLASH_LAYOUT_PAGE_SIZE=4096
CONFIG_NVS=y
CONFIG_NVS_DATA_CRC=y
CONFIG_SETTINGS_NVS=y
CONFIG_HWINFO=y
CONFIG_ENTROPY_GENERATOR=y
CONFIG_CTR_DRBG_CSPRNG_GENERATOR=y
CONFIG_MBEDTLS_SHA256=y
CONFIG_GPIO=y
CONFIG_ADC=y
CONFIG_SERIAL=y
CONFIG_CONSOLE=y
CONFIG_UART_CONSOLE=y
CONFIG_UART_LINE_CTRL=y
CONFIG_USB_DEVICE_STACK=y
CONFIG_USB_DEVICE_INITIALIZE_AT_BOOT=y
CONFIG_USB_DEVICE_PRODUCT="Tingle Registration"
CONFIG_LOG=y
CONFIG_LOG_DEFAULT_LEVEL=3
CONFIG_ASSERT=y
```

## app.overlay
```dts
/* Preserve stock UF2/internal Bluetooth settings and lab records 0..0x40000. */
&p25q16h {
	zephyr,deferred-init;
	partitions {
		compatible = "fixed-partitions";
		#address-cells = <1>;
		#size-cells = <1>;
		registration_store: partition@40000 {
			label = "registration-store";
			reg = <0x00040000 0x00020000>;
		};
	};
};
```

## src/main.c
```c
#include "nus.h"
#include <zephyr/bluetooth/bluetooth.h>
#include <zephyr/kernel.h>
#include <zephyr/settings/settings.h>

static void boot_fault(const char *stage, int error)
{
	for (;;) {
		printk("BOOT failed stage=%s error=%d; no erase or key replacement\n", stage, error);
		k_sleep(K_SECONDS(5));
	}
}

int main(void)
{
	int result = kr_nus_init(NULL);
	if (result) { boot_fault("storage/identity", result); }
	result = bt_enable(NULL);
	if (!result) { result = settings_load(); }
	if (result) { boot_fault("bluetooth", result); }
	const struct bt_data ad[] = {BT_DATA_BYTES(BT_DATA_FLAGS, BT_LE_AD_GENERAL | BT_LE_AD_NO_BREDR),
		BT_DATA_BYTES(BT_DATA_UUID128_ALL, KR_NUS_UUID(0x6e400001))};
	const struct bt_data scan[] = {BT_DATA(BT_DATA_NAME_COMPLETE, CONFIG_BT_DEVICE_NAME,
		sizeof(CONFIG_BT_DEVICE_NAME) - 1)};
	kr_nus_start_window();
	result = bt_le_adv_start(BT_LE_ADV_CONN_FAST_1, ad, ARRAY_SIZE(ad), scan, ARRAY_SIZE(scan));
	if (result) { boot_fault("advertising", result); }
	printk("BOOT NUS ready; registration window=60s; settingsPolicy=UNRESOLVED\n");
	bool window_closed = false;
	for (;;) {
		kr_nus_poll_console(true);
		if (!window_closed && !kr_nus_can_advertise()) {
			bt_le_adv_stop();
			window_closed = true;
			printk("Registration window closed; reboot to reopen\n");
		}
		k_sleep(K_MSEC(250));
	}
}
```

## include/board.h
```c
#ifndef TINGLE_REGISTRATION_BOARD_H
#define TINGLE_REGISTRATION_BOARD_H
#include "registration.h"
int kr_board_open(struct kr_core *core);
struct kr_status kr_board_status(void);
void kr_board_led(bool active);
void kr_board_print_identity(const struct kr_identity *identity);
#endif
```

## include/nus.h
```c
#ifndef TINGLE_REGISTRATION_NUS_H
#define TINGLE_REGISTRATION_NUS_H

#include "peer_plan.h"
#include <stdbool.h>
#include <zephyr/bluetooth/uuid.h>

#define KR_NUS_UUID(value) BT_UUID_128_ENCODE(value, 0xb5a3, 0xf393, 0xe0a9, 0xe50e24dcca9e)

struct k_sem;
int kr_nus_init(struct k_sem *peer_wake);
bool kr_nus_take_peer_plan(struct kr_peer_plan *out);
void kr_nus_start_window(void);
bool kr_nus_can_advertise(void);
void kr_nus_poll_console(bool blink);

#endif
```

## include/registration.h
```c
#ifndef TINGLE_REGISTRATION_H
#define TINGLE_REGISTRATION_H

#include <stdbool.h>
#include <stddef.h>
#include <stdint.h>

#define KR_PROOF_VERSION "tingle-device-proof-v1"
#define KR_FIRMWARE_VERSION "0.1.0-registration"
/* Implementation limits, to be agreed with FE/BE before production rollout. */
#define KR_PAYLOAD_MAX 2048
#define KR_FRAME_MAX 4096
#define KR_RESPONSE_MAX 1536
#define KR_RECORD_MAGIC UINT32_C(0x4b525301)

struct kr_identity {
	char serial[65];
	char key_id[65];
	uint8_t secret[64];
	uint8_t public_key[32];
};

/* One NVS item: metadata and original payload commit together. Never store a
 * partial request. Native layout is versioned by magic; no cross-ABI migration. */
struct kr_settings {
	uint32_t magic;
	uint32_t payload_size;
	int64_t device_id;
	int64_t version;
	char owner_generation[37];
	char sync_run[37];
	char nonce[44];
	char hash[65];
	char format[65];
	uint8_t payload[KR_PAYLOAD_MAX];
};

struct kr_platform {
	void *ctx;
	/* Must complete a durable atomic write AND full readback before returning 0. */
	int (*save)(void *ctx, const struct kr_settings *next);
	/* Verifies authenticated server/owner binding and supported payload schema.
	 * Default board adapter returns POLICY_UNRESOLVED until the contract exists.
	 * SHA256 alone is NOT sender authentication. Called even for retry ACKs. */
	const char *(*authorize)(void *ctx, const struct kr_settings *next);
};

struct kr_core {
	struct kr_identity identity;
	struct kr_settings current;
	struct kr_platform platform;
	bool storage_error;
};

void kr_hash(const void *data, size_t len, uint8_t out[32]);
void kr_hex(const uint8_t *data, size_t len, char *out);
size_t kr_base64_encode(const uint8_t *src, size_t len, char *dst);
int kr_base64_decode(const char *src, uint8_t *dst, size_t capacity);
bool kr_identifier(const char *text);
bool kr_uuid(const char *text);
bool kr_nonce(const char *text);
bool kr_positive(const char *text, int64_t *out);
bool kr_epoch(const char *iso, int64_t *out);
bool kr_settings_valid(const struct kr_settings *settings);
int kr_registration_proof(const struct kr_identity *id, const char *challenge,
	const char *nonce, int64_t expires, char signature[87]);
const char *kr_store(struct kr_core *core, const struct kr_settings *next,
	char signature[87]);

/* Flat JSON requests, strict duplicate/type/overflow checks. Values are decoded
 * in-place only after complete LF framing. No heap or floating-point integers. */
struct kr_field { char *key; char *value; bool string; };
struct kr_json { struct kr_field fields[24]; size_t count; };
bool kr_json_parse(char *text, struct kr_json *out);
const char *kr_json_string(const struct kr_json *obj, const char *key);
const char *kr_json_number(const struct kr_json *obj, const char *key);
size_t kr_json_quote(const char *text, char *out, size_t capacity);

struct kr_status { int battery_mv; int charging; };
struct kr_frame { char bytes[KR_FRAME_MAX + 1]; size_t size; };
/* 0: incomplete, 1: complete, -1: malformed (caller disconnects).
 * A disconnect always resets this object, never the durable settings. */
int kr_frame_push(struct kr_frame *frame, const void *bytes, size_t length);
void kr_frame_reset(struct kr_frame *frame);
void kr_request(struct kr_core *core, char *frame, struct kr_status status,
	bool registration_open, char response[KR_RESPONSE_MAX]);

#endif
```

## src/board.c
```c
#include "board.h"
#include "monocypher.h"
#include "monocypher-ed25519.h"
#include <errno.h>
#include <string.h>
#include <stdio.h>
#include <zephyr/device.h>
#include <zephyr/bluetooth/uuid.h>
#include <zephyr/drivers/adc.h>
#include <zephyr/drivers/gpio.h>
#include <zephyr/drivers/hwinfo.h>
#include <zephyr/fs/nvs.h>
#include <zephyr/kernel.h>
#include <zephyr/random/random.h>
#include <zephyr/storage/flash_map.h>
#include <zephyr/sys/util.h>
#include <hal/nrf_saadc.h>

static struct nvs_fs fs;
static struct kr_settings readback;
static const struct device *gpio = DEVICE_DT_GET(DT_NODELABEL(gpio0));
static const struct device *adc = DEVICE_DT_GET(DT_NODELABEL(adc));
static const struct gpio_dt_spec led = GPIO_DT_SPEC_GET(DT_ALIAS(led2), gpios);
static bool battery_ready;
#ifdef KR_DEV_SERVER_KEY_HEX
static uint8_t server_key[32];
static struct kr_settings_nonce challenge;

static const char *issue_settings_nonce(void *ctx, char out[44])
{
	(void)ctx;
	uint8_t bytes[32];
	if (sys_csrand_get(bytes, sizeof(bytes))) {
		return "RANDOM_ERROR";
	}
	kr_issue_settings_nonce(&challenge, bytes, k_uptime_get());
	memcpy(out, challenge.value, sizeof(challenge.value));
	return NULL;
}
#endif
BUILD_ASSERT(sizeof(struct kr_settings) < 3900, "Atomic NVS record must fit one erase sector");

static int put(uint16_t key, const void *data, size_t length)
{
	ssize_t result = nvs_write(&fs, key, data, length);
	return result == (ssize_t)length || result == 0 ? 0 : result < 0 ? (int)result : -EIO;
}

static int save(void *ctx, const struct kr_settings *next)
{
	(void)ctx;
	int result = put(10, next, sizeof(*next));
	if (result) { return result; }
	ssize_t got = nvs_read(&fs, 10, &readback, sizeof(readback));
	if (got != sizeof(readback) || memcmp(next, &readback, sizeof(readback)) ||
		!kr_settings_valid(&readback)) { return -EIO; }
	return 0;
}

static const char *authorize(void *ctx, const struct kr_settings *next,
	const struct kr_settings_auth *auth, struct kr_peer_plan *plan)
{
#ifdef KR_DEV_SERVER_KEY_HEX
	const struct kr_core *core = ctx;
	const char *error = kr_verify_dev_settings(&core->identity, next, auth,
		&challenge, k_uptime_get(), KR_DEV_SERVER_KEY_ID, server_key, &plan->verified_time);
	if (error) {
		return error;
	}
	if (next->payload[0]) {
		static const uint8_t uuid[] = {KR_DEV_DISCOVERY_UUID};
		memcpy(plan->service_data, uuid, sizeof(uuid));
		if (sys_csrand_get(plan->service_data + sizeof(uuid), KR_DEV_DISCOVERY_BYTES - sizeof(uuid))) {
			return "RANDOM_ERROR";
		}
		plan->length = KR_DEV_DISCOVERY_BYTES;
	}
	return NULL;
#else
	(void)ctx;
	(void)next;
	(void)auth;
	(void)plan;
	/* S15P31E106-225 dependency: Notion sync-runs explicitly returns
	 * POLICY_UNRESOLVED until the official payload provider exists.
	 * No insecure runtime switch: replace this adapter only after agreement on
	 * authenticated owner/server envelope, schema and verification vectors.
	 * https://app.notion.com/p/3ffc91ccb66080d58b62dfbbf647b3b8 */
	return "POLICY_UNRESOLVED";
#endif
}

static int identity(struct kr_identity *id)
{
	uint8_t hardware[8];
	char expected_serial[65] = "XIAO-";
	if (hwinfo_get_device_id(hardware, sizeof(hardware)) != sizeof(hardware)) { return -EIO; }
	kr_hex(hardware, sizeof(hardware), expected_serial + 5);
	ssize_t got = nvs_read(&fs, 1, id, sizeof(*id));
	if (got == -ENOENT) {
		uint8_t marker;
		if (nvs_read(&fs, 2, &marker, sizeof(marker)) != -ENOENT) { return -EILSEQ; }
		memset(id, 0, sizeof(*id));
		uint8_t seed[32];
		if (sys_csrand_get(seed, sizeof(seed))) { return -EIO; }
		crypto_ed25519_key_pair(id->secret, id->public_key, seed);
		strcpy(id->serial, expected_serial);
		strcpy(id->key_id, "ed25519-");
		kr_hex(id->public_key, 8, id->key_id + 8);
		int result = put(1, id, sizeof(*id));
		if (result) { return result; }
		struct kr_identity verify;
		got = nvs_read(&fs, 1, &verify, sizeof(verify));
		bool same = got == sizeof(verify) && !memcmp(id, &verify, sizeof(verify));
		crypto_wipe(&verify, sizeof(verify));
		if (!same) { return -EIO; }
	} else if (got != sizeof(*id)) { return -EILSEQ; }
	if (id->serial[64] || id->key_id[64] || strcmp(id->serial, expected_serial) ||
		!kr_identifier(id->key_id)) { return -EILSEQ; }
	uint8_t seed[32], secret[64], public_key[32];
	memcpy(seed, id->secret, 32);
	crypto_ed25519_key_pair(secret, public_key, seed);
	bool valid = !crypto_verify64(secret, id->secret) && !crypto_verify32(public_key, id->public_key);
	crypto_wipe(secret, sizeof(secret));
	if (!valid) { return -EILSEQ; }
	uint8_t marker = 1;
	return put(2, &marker, sizeof(marker));
}

int kr_board_open(struct kr_core *core)
{
	core->platform = (struct kr_platform){.ctx = core, .save = save, .authorize = authorize};
#ifdef KR_DEV_SERVER_KEY_HEX
	const char *public_hex = KR_DEV_SERVER_KEY_HEX;
	if (hex2bin(public_hex, strlen(public_hex), server_key, sizeof(server_key)) != sizeof(server_key)) {
		return -EINVAL;
	}
	core->platform.issue_settings_nonce = issue_settings_nonce;
#endif
	if (gpio_is_ready_dt(&led)) { gpio_pin_configure_dt(&led, GPIO_OUTPUT_INACTIVE); }
	/* Seeed: P0.14 LOW for VBAT measurement; never drive HIGH while charging.
	 * P0.17 is charge-status input only. HIGH is not a reliable 'full' signal.
	 * https://wiki.seeedstudio.com/XIAO_BLE/ */
	if (device_is_ready(gpio) && device_is_ready(adc)) {
		struct adc_channel_cfg channel = {.gain = ADC_GAIN_1_6, .reference = ADC_REF_INTERNAL,
			.acquisition_time = ADC_ACQ_TIME(ADC_ACQ_TIME_MICROSECONDS, 40),
			.channel_id = 0, .input_positive = NRF_SAADC_INPUT_AIN7};
		battery_ready = !gpio_pin_configure(gpio, 14, GPIO_OUTPUT_LOW) &&
			!gpio_pin_configure(gpio, 17, GPIO_INPUT) && !adc_channel_setup(adc, &channel);
	}
	const struct device *flash = FIXED_PARTITION_DEVICE(registration_store);
	int result = device_is_ready(flash) ? 0 : device_init(flash);
	if (result) { return result; }
	const struct flash_area *area;
	result = flash_area_open(FIXED_PARTITION_ID(registration_store), &area);
	if (result) { return result; }
	fs.flash_device = area->fa_dev;
	fs.offset = area->fa_off;
	fs.sector_size = 4096;
	fs.sector_count = area->fa_size / fs.sector_size;
	result = nvs_mount(&fs);
	flash_area_close(area);
	if (result) { return result; } /* Never auto-format, erase or rotate keys. */
	result = identity(&core->identity);
	if (result) { return result; }
	ssize_t got = nvs_read(&fs, 10, &core->current, sizeof(core->current));
	if (got == -ENOENT) { memset(&core->current, 0, sizeof(core->current)); }
	else if (got != sizeof(core->current) || !kr_settings_valid(&core->current)) { return -EILSEQ; }
	kr_board_print_identity(&core->identity);
	return 0;
}

void kr_board_print_identity(const struct kr_identity *id)
{
	/* Public enrollment material only. The BE trust table must be provisioned
	 * out of band; discovering a public key over BLE does not establish trust.
	 * External flash has no physical extraction protection on this prototype. */
	uint8_t spki[44] = {0x30,0x2a,0x30,0x05,0x06,0x03,0x2b,0x65,0x70,0x03,0x21,0x00};
	char encoded[60];
	memcpy(spki + 12, id->public_key, 32);
	kr_base64_encode(spki, sizeof(spki), encoded);
	printk("ENROLL serial=%s keyId=%s publicKeySpkiBase64url=%s\n",
		id->serial, id->key_id, encoded);
}

struct kr_status kr_board_status(void)
{
	struct kr_status status = {.battery_mv = -1, .charging = -1};
	if (!battery_ready) { return status; }
	int charge = gpio_pin_get(gpio, 17);
	if (charge >= 0) { status.charging = !charge; }
	int16_t raw;
	struct adc_sequence sequence = {.channels = BIT(0), .buffer = &raw,
		.buffer_size = sizeof(raw), .resolution = 12};
	if (!adc_read(adc, &sequence) && raw > 0) {
		int32_t mv = raw;
		if (!adc_raw_to_millivolts(600, ADC_GAIN_1_6, 12, &mv)) {
			/* R16=1M, R17=510k. Voltage does not prove battery presence. */
			status.battery_mv = (mv * 1510 + 255) / 510;
		}
	}
	return status;
}

void kr_board_led(bool active)
{
	if (gpio_is_ready_dt(&led)) { gpio_pin_set_dt(&led, active); }
}
```

## src/frame.c
```c
#include "registration.h"
#include <string.h>

void kr_frame_reset(struct kr_frame *frame) { frame->size = 0; }

int kr_frame_push(struct kr_frame *frame, const void *bytes, size_t length)
{
	const char *data = bytes;
	if (!length || length > 20 || frame->size + length > KR_FRAME_MAX) { return -1; }
	for (size_t i = 0; i < length; ++i) {
		if (!data[i] || (data[i] == '\n' && i != length - 1)) { return -1; }
	}
	memcpy(frame->bytes + frame->size, data, length);
	frame->size += length;
	if (data[length - 1] != '\n') { return 0; }
	frame->bytes[frame->size - 1] = 0;
	return 1;
}
```

## src/hash.c
```c
#include "registration.h"
#ifdef KR_HOST
#include <tinycrypt/sha256.h>
#include <assert.h>
void kr_hash(const void *data, size_t len, uint8_t out[32])
{
	struct tc_sha256_state_struct hash;
	int ok = tc_sha256_init(&hash) && tc_sha256_update(&hash, data, len) && tc_sha256_final(out, &hash);
	assert(ok);
}
#else
#include <mbedtls/sha256.h>
#include <zephyr/sys/__assert.h>
void kr_hash(const void *data, size_t len, uint8_t out[32])
{
	int result = mbedtls_sha256(data, len, out, 0);
	__ASSERT_NO_MSG(result == 0);
}
#endif
```

## src/nus.c
```c
#include "board.h"
#include "nus.h"
#include <errno.h>
#include <string.h>
#include <zephyr/kernel.h>
#include <zephyr/bluetooth/bluetooth.h>
#include <zephyr/bluetooth/conn.h>
#include <zephyr/bluetooth/gatt.h>
#include <zephyr/drivers/uart.h>
#include <zephyr/sys/atomic.h>

static struct bt_uuid_128 service_uuid = BT_UUID_INIT_128(KR_NUS_UUID(0x6e400001));
static struct bt_uuid_128 rx_uuid = BT_UUID_INIT_128(KR_NUS_UUID(0x6e400002));
static struct bt_uuid_128 tx_uuid = BT_UUID_INIT_128(KR_NUS_UUID(0x6e400003));
static struct kr_core core;
static struct k_sem *peer_wake;
static struct kr_peer_plan peer_plan;
static bool peer_pending;
static atomic_t has_settings;
static int64_t window_deadline;
static struct bt_conn *peer;
static uint32_t generation;
static bool ready, busy;
static struct kr_frame incoming;
static char frame[KR_FRAME_MAX + 1], response[KR_RESPONSE_MAX];
K_MUTEX_DEFINE(transport_lock);
K_MUTEX_DEFINE(core_lock);
K_MUTEX_DEFINE(peer_plan_lock);
K_SEM_DEFINE(request_ready, 0, 1);

static ssize_t receive(struct bt_conn *conn, const struct bt_gatt_attr *attr,
	const void *buf, uint16_t len, uint16_t offset, uint8_t flags)
{
	ARG_UNUSED(attr);
	if (offset || (flags & (BT_GATT_WRITE_FLAG_PREPARE | BT_GATT_WRITE_FLAG_CMD)) || !len || len > 20) {
		return BT_GATT_ERR(BT_ATT_ERR_INVALID_ATTRIBUTE_LEN);
	}
	k_mutex_lock(&transport_lock, K_FOREVER);
	if (conn != peer || busy) {
		k_mutex_unlock(&transport_lock);
		return BT_GATT_ERR(BT_ATT_ERR_INSUFFICIENT_RESOURCES);
	}
	int framed = kr_frame_push(&incoming, buf, len);
	if (framed < 0) {
		kr_frame_reset(&incoming);
		k_mutex_unlock(&transport_lock);
		bt_conn_disconnect(conn, BT_HCI_ERR_REMOTE_USER_TERM_CONN);
		return BT_GATT_ERR(BT_ATT_ERR_INVALID_ATTRIBUTE_LEN);
	}
	if (framed == 1) {
		ready = busy = true;
		k_sem_give(&request_ready);
	}
	k_mutex_unlock(&transport_lock);
	return len;
}

static void subscribed(const struct bt_gatt_attr *attr, uint16_t value)
{
	ARG_UNUSED(attr);
	printk("NUS notify=%u\n", value == BT_GATT_CCC_NOTIFY);
}

BT_GATT_SERVICE_DEFINE(nus,
	BT_GATT_PRIMARY_SERVICE(&service_uuid),
	BT_GATT_CHARACTERISTIC(&rx_uuid.uuid, BT_GATT_CHRC_WRITE, BT_GATT_PERM_WRITE, NULL, receive, NULL),
	BT_GATT_CHARACTERISTIC(&tx_uuid.uuid, BT_GATT_CHRC_NOTIFY, BT_GATT_PERM_NONE, NULL, NULL, NULL),
	BT_GATT_CCC(subscribed, BT_GATT_PERM_READ | BT_GATT_PERM_WRITE));

static void connected(struct bt_conn *conn, uint8_t error)
{
	if (error) { return; }
	k_mutex_lock(&transport_lock, K_FOREVER);
	peer = bt_conn_ref(conn);
	++generation;
	kr_frame_reset(&incoming); ready = busy = false;
	k_mutex_unlock(&transport_lock);
	printk("BLE connected\n");
}

static void disconnected(struct bt_conn *conn, uint8_t reason)
{
	k_mutex_lock(&transport_lock, K_FOREVER);
	if (peer == conn) {
		bt_conn_unref(peer); peer = NULL;
		++generation;
		kr_frame_reset(&incoming); ready = busy = false;
	}
	k_mutex_unlock(&transport_lock);
	printk("BLE disconnected reason=%u; incomplete frame discarded\n", reason);
}

BT_CONN_CB_DEFINE(callbacks) = {.connected = connected, .disconnected = disconnected};

static int respond(struct bt_conn *conn, const char *text)
{
	size_t n = strlen(text);
	int64_t deadline = k_uptime_get() + 10000;
	for (size_t offset = 0; offset < n;) {
		size_t count = MIN((size_t)20, n - offset);
		int result = bt_gatt_notify(conn, &nus.attrs[4], text + offset, count);
		if (!result) { offset += count; }
		else if ((result == -ENOMEM || result == -EAGAIN) && k_uptime_get() < deadline) {
			k_msleep(5); /* Transport backpressure only, not a matching queue delay. */
		} else { return result; }
	}
	return 0;
}

int kr_nus_init(struct k_sem *wake)
{
	peer_wake = wake;
	printk("BOOT %s stage=storage\n", KR_FIRMWARE_VERSION);
	int result = kr_board_open(&core);
	atomic_set(&has_settings, core.current.magic != 0);
	return result;
}

static void publish_peer_plan(const struct kr_peer_plan *plan)
{
	if (!peer_wake) {
		return;
	}
	k_mutex_lock(&peer_plan_lock, K_FOREVER);
	peer_plan = *plan;
	peer_pending = true;
	k_mutex_unlock(&peer_plan_lock);
	k_sem_give(peer_wake);
}

bool kr_nus_take_peer_plan(struct kr_peer_plan *out)
{
	k_mutex_lock(&peer_plan_lock, K_FOREVER);
	bool pending = peer_pending;
	if (pending) {
		*out = peer_plan;
		peer_pending = false;
	}
	k_mutex_unlock(&peer_plan_lock);
	return pending;
}

void kr_nus_start_window(void)
{
	window_deadline = k_uptime_get() + 60000;
}

bool kr_nus_can_advertise(void)
{
	return atomic_get(&has_settings) || k_uptime_get() < window_deadline;
}

void kr_nus_poll_console(bool blink)
{
	static int64_t heartbeat;
	static bool light, console_open;
	const struct device *console = DEVICE_DT_GET(DT_CHOSEN(zephyr_console));
	uint32_t dtr;
	if (!uart_line_ctrl_get(console, UART_LINE_CTRL_DTR, &dtr)) {
		if (dtr && !console_open) {
			k_mutex_lock(&core_lock, K_FOREVER);
			printk("DIAG %s NUS ready; settingsPolicy=%s; storedVersion=%lld\n",
				KR_FIRMWARE_VERSION, core.platform.issue_settings_nonce ? "DEV_SIGNED_V1" : "UNRESOLVED",
				(long long)core.current.version);
			kr_board_print_identity(&core.identity);
			k_mutex_unlock(&core_lock);
		}
		console_open = dtr != 0;
	}
	int64_t now = k_uptime_get();
	if (now - heartbeat >= 5000) {
		heartbeat = now;
		if (blink) {
			light = !light;
			kr_board_led(light);
		}
		k_mutex_lock(&core_lock, K_FOREVER);
		struct kr_status status = kr_board_status();
		printk("HEALTH uptime=%lld batteryMv=%d charging=%d storageError=%u\n",
			(long long)(now / 1000), status.battery_mv, status.charging, core.storage_error);
		k_mutex_unlock(&core_lock);
	}
}

static void process_requests(void *a, void *b, void *c)
{
	ARG_UNUSED(a);
	ARG_UNUSED(b);
	ARG_UNUSED(c);
	for (;;) {
		k_sem_take(&request_ready, K_FOREVER);
		struct bt_conn *conn = NULL;
		k_mutex_lock(&transport_lock, K_FOREVER);
		uint32_t request_generation = generation;
		if (ready && peer) {
			memcpy(frame, incoming.bytes, incoming.size);
			conn = bt_conn_ref(peer);
			ready = false;
		}
		k_mutex_unlock(&transport_lock);
		if (!conn) {
			continue;
		}

		k_mutex_lock(&core_lock, K_FOREVER);
		kr_request(&core, frame, kr_board_status(), !core.current.magic &&
			k_uptime_get() < window_deadline, response);
		atomic_set(&has_settings, core.current.magic != 0);
		int64_t stored_version = core.current.version;
		bool stop_peer = core.stop_peer;
		k_mutex_unlock(&core_lock);
		if (stop_peer) {
			const struct kr_peer_plan stopped = {0};
			publish_peer_plan(&stopped);
		}
		int result = respond(conn, response);
		struct kr_peer_plan plan;
		k_mutex_lock(&core_lock, K_FOREVER);
		bool activate_peer = kr_peer_after_response(&core, result == 0, &plan);
		k_mutex_unlock(&core_lock);
		if (activate_peer) {
			publish_peer_plan(&plan);
		}
		printk("NUS response bytes=%u result=%d storedVersion=%lld\n",
			(unsigned)strlen(response), result, (long long)stored_version);
		/* A partial response cannot be followed by a new JSON frame. */
		if (result) { bt_conn_disconnect(conn, BT_HCI_ERR_REMOTE_USER_TERM_CONN); }
		bt_conn_unref(conn);
		k_mutex_lock(&transport_lock, K_FOREVER);
		if (generation == request_generation) { busy = false; kr_frame_reset(&incoming); }
		k_mutex_unlock(&transport_lock);
	}
}

/* Notification backpressure must not stall the lab's scan and matching loop. */
K_THREAD_DEFINE(nus_worker, 6144, process_requests, NULL, NULL, NULL, 7, 0, 0);
```

## src/proof.c
```c
#include "registration.h"
#include "monocypher-ed25519.h"
#include <inttypes.h>
#include <stdio.h>
#include <string.h>

static const char b64[] = "ABCDEFGHIJKLMNOPQRSTUVWXYZabcdefghijklmnopqrstuvwxyz0123456789-_";

void kr_hex(const uint8_t *data, size_t len, char *out)
{
	static const char hex[] = "0123456789abcdef";
	for (size_t i = 0; i < len; ++i) {
		out[2 * i] = hex[data[i] >> 4];
		out[2 * i + 1] = hex[data[i] & 15];
	}
	out[2 * len] = 0;
}

size_t kr_base64_encode(const uint8_t *src, size_t len, char *dst)
{
	size_t n = 0;
	uint32_t bits = 0;
	unsigned count = 0;
	for (size_t i = 0; i < len; ++i) {
		bits = (bits << 8) | src[i];
		count += 8;
		while (count >= 6) {
			count -= 6;
			dst[n++] = b64[(bits >> count) & 63];
		}
	}
	if (count) { dst[n++] = b64[(bits << (6 - count)) & 63]; }
	dst[n] = 0;
	return n;
}

int kr_base64_decode(const char *src, uint8_t *dst, size_t capacity)
{
	if (!src || strlen(src) % 4 == 1) { return -1; }
	size_t n = 0;
	uint32_t bits = 0;
	unsigned count = 0;
	for (; *src; ++src) {
		const char *digit = strchr(b64, *src);
		if (!digit) { return -1; }
		bits = (bits << 6) | (unsigned)(digit - b64);
		count += 6;
		if (count >= 8) {
			count -= 8;
			if (n == capacity) { return -1; }
			dst[n++] = (uint8_t)(bits >> count);
		}
	}
	if (count && (bits & ((1u << count) - 1u))) { return -1; }
	return (int)n;
}

bool kr_identifier(const char *text)
{
	if (!text || !*text || strlen(text) > 64) { return false; }
	for (; *text; ++text) {
		if (!((*text >= 'a' && *text <= 'z') || (*text >= 'A' && *text <= 'Z') ||
			(*text >= '0' && *text <= '9') || strchr("._-", *text))) { return false; }
	}
	return true;
}

bool kr_uuid(const char *text)
{
	if (!text || strlen(text) != 36) { return false; }
	for (size_t i = 0; i < 36; ++i) {
		if (i == 8 || i == 13 || i == 18 || i == 23) {
			if (text[i] != '-') { return false; }
		} else if (!strchr("0123456789abcdef", text[i])) { return false; }
	}
	return true;
}

bool kr_nonce(const char *text)
{
	uint8_t nonce[32];
	return text && strlen(text) == 43 && kr_base64_decode(text, nonce, sizeof(nonce)) == 32;
}

bool kr_positive(const char *text, int64_t *out)
{
	if (!text || *text < '1' || *text > '9') { return false; }
	uint64_t n = 0;
	for (; *text; ++text) {
		if (*text < '0' || *text > '9' || n > ((uint64_t)INT64_MAX - (*text - '0')) / 10) {
			return false;
		}
		n = n * 10 + (unsigned)(*text - '0');
	}
	*out = (int64_t)n;
	return true;
}

/* Server Instant.toString(): UTC, optional fractional seconds. Deliberately no
 * local timezone conversion. The transcript uses getEpochSecond(), not millis. */
bool kr_epoch(const char *iso, int64_t *out)
{
	if (!iso || strlen(iso) < 20) { return false; }
	int v[6] = {0};
	const int start[] = {0, 5, 8, 11, 14, 17};
	const int width[] = {4, 2, 2, 2, 2, 2};
	if (iso[4] != '-' || iso[7] != '-' || iso[10] != 'T' || iso[13] != ':' || iso[16] != ':') {
		return false;
	}
	for (int f = 0; f < 6; ++f) {
		for (int j = 0; j < width[f]; ++j) {
			char c = iso[start[f] + j];
			if (c < '0' || c > '9') { return false; }
			v[f] = v[f] * 10 + c - '0';
		}
	}
	const char *tail = iso + 19;
	if (*tail == '.') {
		const char *fraction = ++tail;
		while (*tail >= '0' && *tail <= '9') { ++tail; }
		if (tail == fraction || tail - fraction > 9) { return false; }
	}
	if (strcmp(tail, "Z") || v[0] < 1970 || v[1] < 1 || v[1] > 12 ||
		v[3] > 23 || v[4] > 59 || v[5] > 59) { return false; }
	const int month_days[] = {31,28,31,30,31,30,31,31,30,31,30,31};
	int leap = v[0] % 4 == 0 && (v[0] % 100 != 0 || v[0] % 400 == 0);
	if (v[2] < 1 || v[2] > month_days[v[1] - 1] + (v[1] == 2 && leap)) { return false; }
	int64_t days = 0;
	for (int year = 1970; year < v[0]; ++year) {
		days += 365 + (year % 4 == 0 && (year % 100 != 0 || year % 400 == 0));
	}
	for (int month = 1; month < v[1]; ++month) {
		days += month_days[month - 1] + (month == 2 && leap);
	}
	*out = ((days + v[2] - 1) * 24 + v[3]) * 3600 + v[4] * 60 + v[5];
	return *out > 0;
}

static int sign_text(const struct kr_identity *id, const char *text, int size, char out[87])
{
	if (size < 0 || size >= 640 || !kr_identifier(id->key_id) || !kr_identifier(id->serial)) {
		return -1;
	}
	uint8_t signature[64];
	crypto_ed25519_sign(signature, id->secret, (const uint8_t *)text, (size_t)size);
	kr_base64_encode(signature, sizeof(signature), out);
	return 0;
}

int kr_registration_proof(const struct kr_identity *id, const char *challenge,
	const char *nonce, int64_t expires, char signature[87])
{
	if (!kr_uuid(challenge) || !kr_nonce(nonce) || expires <= 0) { return -1; }
	char transcript[640];
	int n = snprintf(transcript, sizeof(transcript),
		"TINGLE-KEYRING-REGISTER\n%s\n%s\n%s\n%s\n%s\n%" PRId64 "\n",
		KR_PROOF_VERSION, id->key_id, id->serial, challenge, nonce, expires);
	return sign_text(id, transcript, n, signature);
}

bool kr_settings_valid(const struct kr_settings *s)
{
	/* Check termination before calling string routines on persisted bytes. */
	if (s->magic != KR_RECORD_MAGIC || !s->payload_size || s->payload_size > KR_PAYLOAD_MAX ||
		s->device_id <= 0 || s->version <= 0 || s->owner_generation[36] || s->sync_run[36] ||
		s->nonce[43] || s->hash[64] || s->format[64]) { return false; }
	if (!kr_uuid(s->owner_generation) || !kr_uuid(s->sync_run) || !kr_nonce(s->nonce) ||
		!kr_identifier(s->format) || strlen(s->hash) != 64) { return false; }
	uint8_t digest[32];
	char hex[65];
	kr_hash(s->payload, s->payload_size, digest);
	kr_hex(digest, sizeof(digest), hex);
	return !strcmp(hex, s->hash);
}

const char *kr_store(struct kr_core *core, const struct kr_settings *next,
	const struct kr_settings_auth *auth, char signature[87])
{
	core->peer_after_stored.verified_time = 0;
	core->stop_peer = false;
	if (core->storage_error) { return "STORAGE_ERROR"; }
	if (!kr_settings_valid(next)) { return "INVALID_SETTINGS"; }
	const struct kr_settings *old = &core->current;
	if (old->magic) {
		if (old->device_id != next->device_id || strcmp(old->owner_generation, next->owner_generation)) {
			return "OWNER_MISMATCH";
		}
		if (next->version < old->version) { return "STALE_SETTINGS"; }
		if (next->version == old->version && (strcmp(old->hash, next->hash) ||
			strcmp(old->format, next->format))) { return "VERSION_CONFLICT"; }
	}
	if (!core->platform.authorize) { return "POLICY_UNRESOLVED"; }
	struct kr_peer_plan plan = {0};
	const char *error = core->platform.authorize(core->platform.ctx, next, auth, &plan);
	if (error) { return error; }
	if (plan.verified_time < 0 || plan.length > KR_DISCOVERY_MAX_BYTES ||
		(plan.length && (plan.verified_time == 0 || plan.length < KR_DISCOVERY_UUID_BYTES))) {
		return "INVALID_SETTINGS";
	}
	/* Stop advertising the old state even if the new setting's reply is lost. */
	core->stop_peer = next->version != old->version || (plan.verified_time && !plan.length);
	if (memcmp(old, next, sizeof(*next))) {
		if (!core->platform.save || core->platform.save(core->platform.ctx, next)) {
			/* An uncertain write may have committed. Stop serving mutable requests
			 * until a reboot/readback resolves the authoritative state. */
			core->storage_error = true;
			core->stop_peer = true;
			return "STORAGE_ERROR";
		}
		core->current = *next;
	}
	char transcript[640];
	int n = snprintf(transcript, sizeof(transcript),
		"TINGLE-KEYRING-STORED\n%s\n%s\n%s\n%" PRId64 "\n%s\n%s\n%s\n%" PRId64 "\n%s\nSTORED\n",
		KR_PROOF_VERSION, core->identity.key_id, core->identity.serial, next->device_id,
		next->owner_generation, next->sync_run, next->nonce, next->version, next->hash);
	if (sign_text(&core->identity, transcript, n, signature)) { return "PROOF_ERROR"; }
	core->peer_after_stored = plan;
	return NULL;
}

bool kr_peer_after_response(struct kr_core *core, bool sent, struct kr_peer_plan *out)
{
	bool start = sent && core->peer_after_stored.verified_time > 0 &&
		core->peer_after_stored.length;
	if (start) {
		*out = core->peer_after_stored;
	}
	core->peer_after_stored.verified_time = 0;
	return start;
}
```

## src/request.c
```c
#include "registration.h"
#include <inttypes.h>
#include <stdio.h>
#include <string.h>

/* Called by one application worker, never from a Bluetooth callback. */
static struct kr_settings candidate;

static bool equal(const char *a, const char *b) { return a && !strcmp(a, b); }

static bool field_copy(const struct kr_json *json, const char *key, char *out, size_t capacity)
{
	const char *value = kr_json_string(json, key);
	if (!value || strlen(value) >= capacity) { return false; }
	strcpy(out, value);
	return true;
}

static const char *settings(struct kr_core *core, const struct kr_json *json, char signature[87])
{
	memset(&candidate, 0, sizeof(candidate));
	candidate.magic = KR_RECORD_MAGIC;
	if (!equal(kr_json_string(json, "payloadEncoding"), "base64url") ||
		!equal(kr_json_string(json, "proofProtocolVersion"), KR_PROOF_VERSION) ||
		!equal(kr_json_string(json, "keyId"), core->identity.key_id) ||
		!kr_positive(kr_json_number(json, "deviceId"), &candidate.device_id) ||
		!kr_positive(kr_json_number(json, "settingsVersion"), &candidate.version) ||
		!field_copy(json, "ownerGeneration", candidate.owner_generation, sizeof(candidate.owner_generation)) ||
		!field_copy(json, "syncRunId", candidate.sync_run, sizeof(candidate.sync_run)) ||
		!field_copy(json, "nonce", candidate.nonce, sizeof(candidate.nonce)) ||
		!field_copy(json, "payloadHash", candidate.hash, sizeof(candidate.hash)) ||
		!field_copy(json, "payloadFormat", candidate.format, sizeof(candidate.format))) {
		return "INVALID_SETTINGS";
	}
	int decoded = kr_base64_decode(kr_json_string(json, "payload"), candidate.payload, KR_PAYLOAD_MAX);
	if (decoded <= 0) { return "INVALID_PAYLOAD"; }
	candidate.payload_size = (uint32_t)decoded;
	const struct kr_settings_auth auth = {
		.protocol_version = kr_json_string(json, "serverProofProtocolVersion"),
		.server_key_id = kr_json_string(json, "serverKeyId"),
		.device_nonce = kr_json_string(json, "deviceNonce"),
		.server_time = kr_json_string(json, "serverTime"),
		.signature = kr_json_string(json, "serverSignature"),
	};
	return kr_store(core, &candidate, &auth, signature);
}

void kr_request(struct kr_core *core, char *frame, struct kr_status status,
	bool registration_open, char response[KR_RESPONSE_MAX])
{
	core->stop_peer = false;
	core->peer_after_stored.verified_time = 0;
	struct kr_json json;
	const char *error = "INVALID_MESSAGE";
	char request[224] = "null";
	char signature[87];
	if (!kr_json_parse(frame, &json)) { goto fail; }
	const char *id = kr_json_string(&json, "requestId");
	if (!id || !*id || strlen(id) > 36 || !kr_json_quote(id, request, sizeof(request))) { goto fail; }
	if (!equal(kr_json_number(&json, "protocolVersion"), "1")) {
		error = "UNSUPPORTED_PROTOCOL"; goto fail;
	}
	const char *type = kr_json_string(&json, "type");
	if (equal(type, "GET_DEVICE_INFO")) {
		bool settings_ready = core->platform.issue_settings_nonce != NULL;
		snprintf(response, KR_RESPONSE_MAX,
			"{\"protocolVersion\":1,\"type\":\"DEVICE_INFO\",\"requestId\":%s,"
			"\"deviceSerial\":\"%s\",\"firmwareVersion\":\"%s\",\"supportedProtocolVersions\":[1],"
			"\"supportedFunctions\":[\"GET_DEVICE_INFO\",\"GET_REGISTRATION_PROOF\",\"GET_STATUS\"%s],"
			"\"maxFrameBytes\":%u,\"maxPayloadBytes\":%u,\"settingsPolicy\":\"%s\","
			"\"storedSettingsVersion\":%" PRId64 ",\"storedPayloadHash\":\"%s\","
			"\"storageHealthy\":%s,\"applied\":false,\"timeReady\":false}\n",
			request, core->identity.serial, KR_FIRMWARE_VERSION,
			settings_ready ? ",\"GET_SYNC_CHALLENGE\",\"SYNC_SETTINGS\"" : "",
			KR_FRAME_MAX, KR_PAYLOAD_MAX, settings_ready ? "DEV_SIGNED_V1" : "UNRESOLVED",
			core->current.version, core->current.hash, core->storage_error ? "false" : "true");
		return;
	}
	if (equal(type, "GET_SYNC_CHALLENGE")) {
		char nonce[44];
		error = core->platform.issue_settings_nonce ?
			core->platform.issue_settings_nonce(core->platform.ctx, nonce) : "POLICY_UNRESOLVED";
		if (error) { goto fail; }
		snprintf(response, KR_RESPONSE_MAX,
			"{\"protocolVersion\":1,\"type\":\"SYNC_CHALLENGE\",\"requestId\":%s,"
			"\"deviceNonce\":\"%s\",\"expiresInSeconds\":%d}\n",
			request, nonce, KR_SETTINGS_CHALLENGE_SECONDS);
		return;
	}
	if (equal(type, "GET_STATUS")) {
		char mv[20];
		if (status.battery_mv >= 0) { snprintf(mv, sizeof(mv), "%d", status.battery_mv); }
		else { strcpy(mv, "null"); }
		snprintf(response, KR_RESPONSE_MAX,
			"{\"protocolVersion\":1,\"type\":\"STATUS\",\"requestId\":%s,"
			"\"batteryPercent\":null,\"batteryMillivolts\":%s,\"charging\":%s,"
			"\"storageTotalBytes\":null,\"storageUsedBytes\":null,"
			"\"storageState\":\"UNKNOWN\",\"pendingRecordCount\":null}\n",
			request, mv, status.charging < 0 ? "null" : status.charging ? "true" : "false");
		return;
	}
	if (equal(type, "GET_REGISTRATION_PROOF")) {
		if (!registration_open) { error = "REGISTRATION_WINDOW_CLOSED"; goto fail; }
		int64_t expires;
		if (!equal(kr_json_string(&json, "proofProtocolVersion"), KR_PROOF_VERSION) ||
			!kr_epoch(kr_json_string(&json, "expiresAt"), &expires) ||
			kr_registration_proof(&core->identity, kr_json_string(&json, "challengeId"),
				kr_json_string(&json, "nonce"), expires, signature)) { goto fail; }
		/* Expiry and single-use remain server checks while no trusted clock exists. */
		snprintf(response, KR_RESPONSE_MAX,
			"{\"protocolVersion\":1,\"type\":\"REGISTRATION_PROOF\",\"requestId\":%s,"
			"\"deviceSerial\":\"%s\",\"proof\":{\"protocolVersion\":\"%s\",\"keyId\":\"%s\","
			"\"signature\":\"%s\"}}\n", request, core->identity.serial, KR_PROOF_VERSION,
			core->identity.key_id, signature);
		return;
	}
	if (equal(type, "SYNC_SETTINGS")) {
		error = settings(core, &json, signature);
		if (error) { goto fail; }
		snprintf(response, KR_RESPONSE_MAX,
			"{\"protocolVersion\":1,\"type\":\"SETTINGS_RESULT\",\"requestId\":%s,"
			"\"syncRunId\":\"%s\",\"settingsVersion\":%" PRId64 ",\"payloadHash\":\"%s\","
			"\"stored\":true,\"applied\":false,\"timeReady\":false,"
			"\"proof\":{\"protocolVersion\":\"%s\",\"keyId\":\"%s\",\"signature\":\"%s\"}}\n",
			request, candidate.sync_run, candidate.version, candidate.hash, KR_PROOF_VERSION,
			core->identity.key_id, signature);
		return;
	}
	error = "UNSUPPORTED_TYPE";
fail:
	snprintf(response, KR_RESPONSE_MAX,
		"{\"protocolVersion\":1,\"type\":\"ERROR\",\"requestId\":%s,\"code\":\"%s\"}\n", request, error);
}
```
