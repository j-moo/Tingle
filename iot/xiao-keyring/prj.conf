## CMakeLists.txt
```
cmake_minimum_required(VERSION 3.20.0)
find_package(Zephyr 4.2.0 REQUIRED HINTS $ENV{ZEPHYR_BASE})
project(tingle_keyring C)
option(KR_DIAG_INTERACTIVE_BOOT "Pause boot stages for USB hardware diagnostics" OFF)
target_include_directories(app PRIVATE include)
target_sources(app PRIVATE src/main.c src/codec.c src/engine.c src/phone.c src/storage.c)
set(REGISTRATION_DIR "${CMAKE_CURRENT_SOURCE_DIR}/../xiao-registration")
target_include_directories(app PRIVATE "${REGISTRATION_DIR}/include" "${REGISTRATION_DIR}/vendor/monocypher")
target_sources(app PRIVATE
  "${REGISTRATION_DIR}/src/nus.c"
  "${REGISTRATION_DIR}/src/board.c"
  "${REGISTRATION_DIR}/src/proof.c"
  "${REGISTRATION_DIR}/src/settings_auth.c"
  "${REGISTRATION_DIR}/src/hash.c"
  "${REGISTRATION_DIR}/src/json.c"
  "${REGISTRATION_DIR}/src/request.c"
  "${REGISTRATION_DIR}/src/frame.c"
  "${REGISTRATION_DIR}/vendor/monocypher/monocypher.c"
  "${REGISTRATION_DIR}/vendor/monocypher/monocypher-ed25519.c")
set(KR_DEV_SETTINGS_PUBLIC_KEY "" CACHE STRING "Pinned development Ed25519 public key (raw hex)")
if(NOT KR_DEV_SETTINGS_PUBLIC_KEY STREQUAL "")
  string(LENGTH "${KR_DEV_SETTINGS_PUBLIC_KEY}" key_length)
  if(NOT key_length EQUAL 64 OR NOT KR_DEV_SETTINGS_PUBLIC_KEY MATCHES "^[0-9a-f]+$")
    message(FATAL_ERROR "KR_DEV_SETTINGS_PUBLIC_KEY must be 64 lowercase hex characters")
  endif()
  string(SUBSTRING "${KR_DEV_SETTINGS_PUBLIC_KEY}" 0 16 key_prefix)
  target_compile_definitions(app PRIVATE
    KR_FIRMWARE_VERSION="0.2.3-dev-signed"
    KR_DEV_SERVER_KEY_HEX="${KR_DEV_SETTINGS_PUBLIC_KEY}"
    KR_DEV_SERVER_KEY_ID="dev-ed25519-${key_prefix}")
else()
  target_compile_definitions(app PRIVATE KR_FIRMWARE_VERSION="0.2.3-unified")
endif()
target_compile_options(app PRIVATE -Wall -Wextra -Werror -fstack-usage)
if(KR_DIAG_INTERACTIVE_BOOT)
  target_compile_definitions(app PRIVATE KR_DIAG_INTERACTIVE_BOOT=1)
endif()
```

## west.yml
```
manifest:
  remotes:
    - name: zephyrproject
      url-base: https://github.com/zephyrproject-rtos
  projects:
    - name: zephyr
      remote: zephyrproject
      revision: v4.2.0
      import:
        name-allowlist:
          - cmsis
          - cmsis_6
          - hal_nordic
          - segger
          - tinycrypt
          - mbedtls
  self:
    path: xiao-keyring
```

## prj.conf
```kconfig
CONFIG_BT=y
CONFIG_BT_PERIPHERAL=y
CONFIG_BT_OBSERVER=y
CONFIG_BT_BROADCASTER=y
CONFIG_BT_DEVICE_NAME="Tingle-Keyring"
CONFIG_BT_MAX_CONN=1
CONFIG_BT_SMP=y
CONFIG_BT_SETTINGS=y
CONFIG_BT_MAX_PAIRED=4
CONFIG_SETTINGS=y
CONFIG_BT_EXT_ADV=y
CONFIG_BT_EXT_ADV_MAX_ADV_SET=2
CONFIG_BT_CTLR_ADVANCED_FEATURES=y
CONFIG_BT_CTLR_ADV_DATA_CHAIN=y
CONFIG_BT_CTLR_ADV_DATA_LEN_MAX=1650
CONFIG_BT_CTLR_ADV_DATA_BUF_MAX=4
CONFIG_BT_EXT_SCAN_BUF_SIZE=1650
CONFIG_BT_CTLR_SCAN_DATA_LEN_MAX=1650
CONFIG_BT_BUF_EVT_RX_COUNT=16
CONFIG_BT_CTLR_RX_BUFFERS=9
CONFIG_BT_CTLR_SCAN_AUX_SET=3
CONFIG_BT_RX_STACK_SIZE=4096
# ECC key generation calls CTR-DRBG initialization on the Bluetooth long workqueue.
# The default 1400-byte stack cannot hold its nested seed/derivation buffers.
CONFIG_BT_LONG_WQ_STACK_SIZE=4096
CONFIG_SYSTEM_WORKQUEUE_STACK_SIZE=4096
CONFIG_MAIN_STACK_SIZE=12288
CONFIG_HEAP_MEM_POOL_SIZE=8192
# PSA/Mbed TLS uses libc calloc, separate from the kernel heap above.
CONFIG_COMMON_LIBC_MALLOC_ARENA_SIZE=16384
CONFIG_FLASH=y
CONFIG_FLASH_MAP=y
CONFIG_FLASH_PAGE_LAYOUT=y
# NVS uses 4 KiB erase sectors; the QSPI driver's default layout is 64 KiB.
CONFIG_NORDIC_QSPI_NOR_FLASH_LAYOUT_PAGE_SIZE=4096
CONFIG_NVS=y
CONFIG_NVS_DATA_CRC=y
CONFIG_SETTINGS_NVS=y
CONFIG_HWINFO=y
CONFIG_ENTROPY_GENERATOR=y
CONFIG_CTR_DRBG_CSPRNG_GENERATOR=y
CONFIG_MBEDTLS_SHA256=y
CONFIG_GPIO=y
CONFIG_ADC=y
CONFIG_SERIAL=y
CONFIG_CONSOLE=y
CONFIG_UART_CONSOLE=y
CONFIG_UART_LINE_CTRL=y
CONFIG_USB_DEVICE_STACK=y
CONFIG_USB_DEVICE_INITIALIZE_AT_BOOT=y
CONFIG_USB_DEVICE_PRODUCT="Tingle Unified Keyring"
CONFIG_LOG=y
CONFIG_LOG_DEFAULT_LEVEL=3
CONFIG_ASSERT=y
```

## app.overlay
```dts
/* Keep the stock UF2 bootloader/code/internal settings partitions unchanged. */
&p25q16h {
	/* Bring up USB diagnostics before probing the external flash chip. */
	zephyr,deferred-init;
	partitions {
		compatible = "fixed-partitions";
		#address-cells = <1>;
		#size-cells = <1>;
		keyring_store: partition@0 {
			label = "keyring-store";
			reg = <0x00000000 0x00040000>;
		};
		/* Same offsets as the installed registration build. */
		registration_store: partition@40000 {
			label = "registration-store";
			reg = <0x00040000 0x00020000>;
		};
	};
};
```

## include/keyring.h
```c
#ifndef TINGLE_KEYRING_H
#define TINGLE_KEYRING_H

#include <stdbool.h>
#include <stddef.h>
#include <stdint.h>

/* Test protocol, not the approved production proof/payload contract. */
#define KR_VERSION 1
#define KR_DATA_MAX 1024
#define KR_WIRE_MAX 1200
#define KR_RECORDS 32
#define KR_SUPPRESSIONS 64
#define KR_MATCH_LIMIT 8
#define KR_CONFIRMED_LIMIT 12
#define KR_REVIEW_LIMIT 12
#define KR_PROFILE_BYTES (34 + KR_DATA_MAX)
#define KR_FRAME_MAX 2500

enum kr_kind { KR_EMPTY, KR_MATCH, KR_CONFIRMED, KR_REVIEW };
enum kr_phase { KR_NEW, KR_WAIT, KR_OFFER, KR_PREPARED, KR_COMMIT,
	KR_DONE, KR_FINAL, KR_COMPLETE };
enum kr_reason { KR_REASON_NONE, KR_BAD_DATA, KR_ALGORITHM_ERROR,
	KR_ALGORITHM_REJECT, KR_VERSION_MISMATCH, KR_SETTINGS_CHANGED,
	KR_RADIO_OVERFLOW };
enum kr_result { KR_OK, KR_INVALID, KR_UNAUTHORIZED, KR_STALE,
	KR_FULL, KR_STORAGE, KR_NOT_READY, KR_NOT_FOUND, KR_CONFLICT };
enum kr_decision { KR_ACCEPT, KR_REJECT, KR_CALC_ERROR };

struct kr_profile {
	uint32_t revision;
	uint32_t policy;
	uint32_t rule;
	uint32_t opportunity_sec;
	uint8_t snapshot[16];
	uint16_t data_len;
	uint8_t data[KR_DATA_MAX];
};

struct kr_config {
	uint32_t format;
	uint64_t device;
	uint8_t owner[16];
	uint8_t token[16];
	uint8_t registered;
	struct kr_profile profile;
};

struct kr_record {
	uint32_t format;
	uint32_t sequence;
	uint64_t peer;
	uint64_t occurred_at;
	uint64_t expires_at;
	uint8_t id[16];
	uint8_t kind;
	uint8_t phase;
	uint8_t reason;
	uint8_t feedback_claimed;
	struct kr_profile own;
	uint16_t peer_len;
	uint8_t peer_wire[KR_WIRE_MAX];
};

struct kr_suppression {
	uint64_t peer;
	uint8_t id[16];
	uint64_t occurred_at;
	uint64_t expires_at;
	uint32_t own_revision;
	uint32_t peer_revision;
	uint8_t phase;
};

struct kr_io {
	/* Return zero only after durable storage. An EMPTY slot is a deletion. */
	int (*config)(void *, const struct kr_config *);
	int (*record)(void *, unsigned, const struct kr_record *);
	int (*suppression)(void *, unsigned, const struct kr_suppression *);
	void (*random)(void *, uint8_t *, size_t);
	void (*feedback)(void *, const uint8_t id[16]);
	enum kr_decision (*calculate)(void *, const struct kr_profile *,
		const struct kr_profile *);
	bool synthetic_only;
	void *ctx;
};

struct kr_engine {
	struct kr_config config;
	struct kr_record records[KR_RECORDS];
	struct kr_suppression suppressed[KR_SUPPRESSIONS];
	struct kr_io io;
	uint32_t next_sequence;
	uint32_t overflow;
	bool ready;
	bool storage_error;
};

uint16_t kr_get16(const uint8_t *p);
uint32_t kr_get32(const uint8_t *p);
uint64_t kr_get64(const uint8_t *p);
void kr_put16(uint8_t *p, uint16_t n);
void kr_put32(uint8_t *p, uint32_t n);
void kr_put64(uint8_t *p, uint64_t n);
uint32_t kr_crc32(const uint8_t *data, size_t len);
size_t kr_profile_encode(const struct kr_profile *p, uint8_t *out);
bool kr_profile_decode(struct kr_profile *p, const uint8_t *in, size_t len);
size_t kr_packet(uint8_t type, const uint8_t *body, size_t len, uint8_t *out);
bool kr_packet_valid(const uint8_t *in, size_t len);
size_t kr_record_encode(const struct kr_record *r, uint8_t *out);

void kr_init(struct kr_engine *e, uint64_t device, struct kr_io io);
bool kr_restored_valid(struct kr_engine *e);
enum kr_result kr_register(struct kr_engine *e, const uint8_t owner[16],
	const uint8_t token[16]);
bool kr_auth(const struct kr_engine *e, const uint8_t token[16]);
enum kr_result kr_sync(struct kr_engine *e, const struct kr_profile *p);
enum kr_result kr_receive(struct kr_engine *e, const uint8_t *wire,
	size_t len, uint64_t source, uint64_t now);
enum kr_result kr_radio_error(struct kr_engine *e, uint64_t source,
	const uint8_t *raw, size_t len, enum kr_reason reason, uint64_t now);
/* Run every runnable job immediately; radio-dependent phases never block others. */
void kr_drain(struct kr_engine *e);
void kr_expire_candidates(struct kr_engine *e, uint64_t now);
size_t kr_advertisement(struct kr_engine *e, unsigned *cursor, uint8_t *out,
	int *sent_slot);
void kr_sent(struct kr_engine *e, int slot);
enum kr_result kr_ack(struct kr_engine *e, const uint8_t id[16]);
enum kr_result kr_release(struct kr_engine *e, const uint8_t id[16]);
unsigned kr_count(const struct kr_engine *e, enum kr_kind kind);
enum kr_decision kr_always_match(void *ctx, const struct kr_profile *a,
	const struct kr_profile *b);

#endif
```

## include/storage.h
```c
#ifndef TINGLE_STORAGE_H
#define TINGLE_STORAGE_H
#include "keyring.h"
int kr_storage_open(struct kr_engine *e);
int kr_storage_config(void *ctx, const struct kr_config *config);
int kr_storage_record(void *ctx, unsigned slot, const struct kr_record *record);
int kr_storage_suppression(void *ctx, unsigned slot, const struct kr_suppression *s);
#endif
```

## src/engine.c
```c
#include "keyring.h"
#include <string.h>

static bool equal_id(const uint8_t *a, const uint8_t *b)
{
	return memcmp(a, b, 16) == 0;
}

static bool nonzero(const uint8_t *p, size_t n)
{
	uint8_t result = 0;
	for (size_t i = 0; i < n; ++i) {
		result |= p[i];
	}
	return result != 0;
}

static enum kr_result save(struct kr_engine *e, unsigned slot,
	const struct kr_record *r)
{
	if (e->storage_error || e->io.record(e->io.ctx, slot, r)) {
		e->storage_error = true;
		e->ready = false;
		return KR_STORAGE;
	}
	e->records[slot] = *r;
	return KR_OK;
}

void kr_init(struct kr_engine *e, uint64_t device, struct kr_io io)
{
	memset(e, 0, sizeof(*e));
	e->config.format = KR_VERSION;
	e->config.device = device;
	e->io = io;
	e->next_sequence = 1;
}

bool kr_restored_valid(struct kr_engine *e)
{
	if (e->config.format != KR_VERSION || !e->config.device ||
		e->config.profile.data_len > KR_DATA_MAX ||
		(e->config.registered && (!nonzero(e->config.owner, 16) ||
		!nonzero(e->config.token, 16)))) {
		return false;
	}
	for (unsigned i = 0; i < KR_RECORDS; ++i) {
		const struct kr_record *r = &e->records[i];
		if (r->kind != KR_EMPTY && (r->format != KR_VERSION ||
			r->kind > KR_REVIEW || r->phase > KR_COMPLETE ||
			r->peer_len > KR_WIRE_MAX || r->own.data_len > KR_DATA_MAX ||
			r->sequence == UINT32_MAX)) {
			return false;
		}
		if (r->kind == KR_MATCH || r->kind == KR_CONFIRMED) {
			struct kr_profile peer;
			if (r->peer_len < 52 || !kr_packet_valid(r->peer_wire, r->peer_len) ||
				r->peer_wire[3] != 1 || kr_get64(r->peer_wire + 6) != r->peer ||
				!kr_profile_decode(&peer, r->peer_wire + 14, r->peer_len - 18)) {
				return false;
			}
		}
		if (r->kind && r->sequence >= e->next_sequence) {
			e->next_sequence = r->sequence + 1;
		}
	}
	/* Persistent settings are not a trusted wall clock after a power cycle. */
	e->ready = false;
	return true;
}

bool kr_auth(const struct kr_engine *e, const uint8_t token[16])
{
	uint8_t difference = 0;
	for (unsigned i = 0; i < 16; ++i) {
		difference |= token[i] ^ e->config.token[i];
	}
	return e->config.registered && difference == 0;
}

enum kr_result kr_register(struct kr_engine *e, const uint8_t owner[16],
	const uint8_t token[16])
{
	if (!nonzero(owner, 16) || !nonzero(token, 16)) {
		return KR_INVALID;
	}
	if (e->config.registered) {
		return kr_auth(e, token) && equal_id(owner, e->config.owner) ?
			KR_OK : KR_UNAUTHORIZED;
	}
	struct kr_config next = e->config;
	memcpy(next.owner, owner, 16);
	memcpy(next.token, token, 16);
	next.registered = 1;
	if (e->storage_error || e->io.config(e->io.ctx, &next)) {
		return KR_STORAGE;
	}
	e->config = next;
	return KR_OK;
}

static bool synthetic_profile(const struct kr_profile *profile)
{
	if (profile->data_len != KR_DATA_MAX) {
		return false;
	}
	for (unsigned i = 0; i < KR_DATA_MAX; ++i) {
		if (profile->data[i] != (uint8_t)i) {
			return false;
		}
	}
	return true;
}

enum kr_result kr_sync(struct kr_engine *e, const struct kr_profile *p)
{
	uint8_t encoded[KR_PROFILE_BYTES];
	struct kr_profile normalized;
	size_t len = kr_profile_encode(p, encoded);
	if (!e->config.registered || !len || !kr_profile_decode(&normalized, encoded, len) ||
		(e->io.synthetic_only && !synthetic_profile(&normalized))) {
		return KR_INVALID;
	}
	if (p->revision < e->config.profile.revision) {
		return KR_STALE;
	}
	if (p->revision == e->config.profile.revision &&
		memcmp(&normalized, &e->config.profile, sizeof(normalized))) {
		return KR_CONFLICT;
	}
	struct kr_config next = e->config;
	next.profile = normalized;
	if (e->storage_error || e->io.config(e->io.ctx, &next)) {
		e->ready = false;
		return KR_STORAGE;
	}
	e->config = next;
	e->ready = true;
	return KR_OK;
}

unsigned kr_count(const struct kr_engine *e, enum kr_kind kind)
{
	unsigned n = 0;
	for (unsigned i = 0; i < KR_RECORDS; ++i) {
		n += e->records[i].kind == kind;
	}
	return n;
}

static int existing(const struct kr_engine *e, uint64_t peer)
{
	for (unsigned i = 0; i < KR_RECORDS; ++i) {
		if (e->records[i].kind && e->records[i].peer == peer) {
			return (int)i;
		}
	}
	return -1;
}

static bool suppressed(const struct kr_engine *e, uint64_t peer)
{
	for (unsigned i = 0; i < KR_SUPPRESSIONS; ++i) {
		if (e->suppressed[i].peer == peer) {
			return true;
		}
	}
	return false;
}

static enum kr_result save_suppression(struct kr_engine *e, unsigned slot,
	const struct kr_suppression *s)
{
	if (e->io.suppression(e->io.ctx, slot, s)) {
		return KR_STORAGE;
	}
	e->suppressed[slot] = *s;
	return KR_OK;
}

static enum kr_result insert(struct kr_engine *e, struct kr_record *r)
{
	unsigned limit = r->kind == KR_MATCH ? KR_MATCH_LIMIT : KR_REVIEW_LIMIT;
	if (kr_count(e, (enum kr_kind)r->kind) >= limit ||
		e->next_sequence == UINT32_MAX) {
		++e->overflow;
		return KR_FULL;
	}
	for (unsigned i = 0; i < KR_RECORDS; ++i) {
		if (e->records[i].kind == KR_EMPTY) {
			r->format = KR_VERSION;
			r->sequence = e->next_sequence;
			enum kr_result result = save(e, i, r);
			if (result == KR_OK) {
				++e->next_sequence;
			}
			return result;
		}
	}
	++e->overflow;
	return KR_FULL;
}

enum kr_result kr_radio_error(struct kr_engine *e, uint64_t source,
	const uint8_t *raw, size_t len, enum kr_reason reason, uint64_t now)
{
	if (!e->ready || len > KR_WIRE_MAX) {
		return KR_NOT_READY;
	}
	/* Error keys use a separate namespace; bad bytes are evidence, not identity. */
	uint64_t key = (1ULL << 63) | ((uint64_t)kr_crc32(raw, len) << 16) |
		(source & 0xffff);
	if (existing(e, key) >= 0 || suppressed(e, key)) {
		return KR_OK;
	}
	struct kr_record r = {0};
	r.kind = KR_REVIEW;
	r.reason = reason;
	r.phase = KR_COMPLETE;
	r.peer = key;
	r.occurred_at = now;
	r.expires_at = now + e->config.profile.opportunity_sec;
	r.own = e->config.profile;
	r.peer_len = (uint16_t)len;
	memcpy(r.peer_wire, raw, len);
	e->io.random(e->io.ctx, r.id, sizeof(r.id));
	return insert(e, &r);
}

static enum kr_result review(struct kr_engine *e, unsigned slot,
	struct kr_record *r, enum kr_reason reason)
{
	if (kr_count(e, KR_REVIEW) >= KR_REVIEW_LIMIT) {
		/* Keep a failed calculation durable without recalculating on every radio event. */
		if (!r->reason) {
			r->reason = reason;
			r->phase = KR_NEW;
			return save(e, slot, r) == KR_OK ? KR_FULL : KR_STORAGE;
		}
		return KR_FULL;
	}
	r->kind = KR_REVIEW;
	r->phase = KR_COMPLETE;
	r->reason = reason;
	if (!nonzero(r->id, 16)) {
		e->io.random(e->io.ctx, r->id, 16);
	}
	return save(e, slot, r);
}

enum kr_decision kr_always_match(void *ctx, const struct kr_profile *a,
	const struct kr_profile *b)
{
	(void)ctx;
	(void)a;
	(void)b;
	return KR_ACCEPT;
}

void kr_expire_candidates(struct kr_engine *e, uint64_t now)
{
	if (!e->ready || e->storage_error || !now) {
		return;
	}
	static const struct kr_record empty;
	for (unsigned i = 0; i < KR_RECORDS; ++i) {
		const struct kr_record *r = &e->records[i];
		/* Retain confirmed records and calculation failures for upload. */
		if (r->kind == KR_MATCH && !r->reason && r->expires_at && now >= r->expires_at &&
			save(e, i, &empty) != KR_OK) {
			break;
		}
	}
}

void kr_drain(struct kr_engine *e)
{
	if (!e->ready || e->storage_error) {
		return;
	}
	/* Sequence order is independent of reused flash slot numbers. */
	uint32_t after = 0;
	for (unsigned n = 0; n < KR_RECORDS; ++n) {
		int slot = -1;
		for (unsigned i = 0; i < KR_RECORDS; ++i) {
			const struct kr_record *r = &e->records[i];
			if (r->kind == KR_MATCH && r->phase == KR_NEW && r->sequence > after &&
				(slot < 0 || r->sequence < e->records[slot].sequence)) {
				slot = (int)i;
			}
		}
		if (slot < 0) {
			break;
		}
		struct kr_record r = e->records[slot];
		after = r.sequence;
		if (r.reason) {
			(void)review(e, (unsigned)slot, &r, (enum kr_reason)r.reason);
			continue;
		}
		struct kr_profile peer;
		if (!kr_profile_decode(&peer, r.peer_wire + 14, r.peer_len - 18)) {
			(void)review(e, (unsigned)slot, &r, KR_BAD_DATA);
			continue;
		}
		if (r.own.revision != e->config.profile.revision) {
			(void)review(e, (unsigned)slot, &r, KR_SETTINGS_CHANGED);
			continue;
		}
		if (r.own.policy != peer.policy || r.own.rule != peer.rule ||
			r.own.opportunity_sec != peer.opportunity_sec) {
			(void)review(e, (unsigned)slot, &r, KR_VERSION_MISMATCH);
			continue;
		}
		enum kr_decision decision = e->io.calculate(e->io.ctx, &r.own, &peer);
		if (decision != KR_ACCEPT) {
			(void)review(e, (unsigned)slot, &r, decision == KR_REJECT ?
				KR_ALGORITHM_REJECT : KR_ALGORITHM_ERROR);
			continue;
		}
		r.phase = e->config.device < r.peer ? KR_OFFER : KR_WAIT;
		if (r.phase == KR_OFFER) {
			e->io.random(e->io.ctx, r.id, 16);
		}
		if (save(e, (unsigned)slot, &r) != KR_OK) {
			break;
		}
	}
}

static enum kr_result control(struct kr_engine *e, const uint8_t *p, size_t len,
	uint64_t now)
{
	if (len != 65 || kr_get64(p + 8) != e->config.device) {
		return KR_INVALID;
	}
	uint64_t peer_id = kr_get64(p);
	int slot = existing(e, peer_id);
	if (slot < 0) {
		/* A phone can upload/delete one side before the last over-air receipt arrives. */
		for (unsigned i = 0; i < KR_SUPPRESSIONS; ++i) {
			struct kr_suppression s = e->suppressed[i];
			if (s.peer != peer_id || !equal_id(s.id, p + 16) ||
				s.occurred_at != kr_get64(p + 32) || s.expires_at != kr_get64(p + 40) ||
				s.peer_revision != kr_get32(p + 56) || s.own_revision != kr_get32(p + 60)) {
				continue;
			}
			if (peer_id < e->config.device && p[64] == KR_COMMIT) {
				s.phase = KR_DONE;
			} else if (peer_id > e->config.device && p[64] == KR_DONE) {
				s.phase = KR_FINAL;
			} else if (peer_id < e->config.device && p[64] == KR_FINAL) {
				s.phase = KR_COMPLETE;
			} else {
				return KR_OK;
			}
			return save_suppression(e, i, &s);
		}
		return KR_NOT_FOUND;
	}
	struct kr_record r = e->records[slot];
	if (r.kind == KR_REVIEW || !nonzero(p + 16, 16)) {
		return KR_CONFLICT;
	}
	struct kr_profile peer;
	if (!kr_profile_decode(&peer, r.peer_wire + 14, r.peer_len - 18) ||
		kr_get32(p + 56) != peer.revision || kr_get32(p + 60) != r.own.revision) {
		return KR_CONFLICT;
	}
	if (r.kind == KR_MATCH && r.own.revision != e->config.profile.revision) {
		return review(e, (unsigned)slot, &r, KR_SETTINGS_CHANGED);
	}
	bool coordinator = e->config.device < peer_id;
	uint8_t phase = p[64];
	if (phase == KR_OFFER && !coordinator && r.phase == KR_WAIT) {
		uint64_t occurred = kr_get64(p + 32);
		uint64_t expires = kr_get64(p + 40);
		if (!occurred || expires < occurred || expires - occurred != r.own.opportunity_sec ||
			now >= expires) {
			return KR_INVALID;
		}
		memcpy(r.id, p + 16, 16);
		r.occurred_at = occurred;
		r.expires_at = expires;
		r.phase = KR_PREPARED;
		return save(e, (unsigned)slot, &r);
	}
	if (!equal_id(r.id, p + 16) || r.occurred_at != kr_get64(p + 32) ||
		r.expires_at != kr_get64(p + 40)) {
		return KR_CONFLICT;
	}
	bool confirm = false;
	if (phase == KR_PREPARED && coordinator && r.phase == KR_OFFER) {
		r.phase = KR_COMMIT;
	} else if (phase == KR_COMMIT && !coordinator && r.phase == KR_PREPARED) {
		r.phase = KR_DONE;
		confirm = true;
	} else if (phase == KR_DONE && coordinator && r.phase == KR_COMMIT) {
		r.phase = KR_FINAL;
		confirm = true;
	} else if (phase == KR_DONE && coordinator && r.phase == KR_COMPLETE) {
		r.phase = KR_FINAL; /* Recover a lost FINAL without another feedback. */
	} else if (phase == KR_FINAL && !coordinator && r.phase == KR_DONE) {
		r.phase = KR_COMPLETE;
	} else {
		return KR_OK;
	}
	if (confirm) {
		if (now >= r.expires_at) {
			return KR_STALE;
		}
		if (kr_count(e, KR_CONFIRMED) >= KR_CONFIRMED_LIMIT) {
			return KR_FULL;
		}
		r.kind = KR_CONFIRMED;
		/* Claim is durable BEFORE hardware output: recovery never repeats output. */
		r.feedback_claimed = 1;
	}
	enum kr_result result = save(e, (unsigned)slot, &r);
	if (result == KR_OK && confirm && e->io.feedback) {
		e->io.feedback(e->io.ctx, r.id);
	}
	return result;
}

enum kr_result kr_receive(struct kr_engine *e, const uint8_t *wire, size_t len,
	uint64_t source, uint64_t now)
{
	if (!e->ready || !now || e->storage_error) {
		return KR_NOT_READY;
	}
	if (!kr_packet_valid(wire, len)) {
		return kr_radio_error(e, source, wire, len, KR_BAD_DATA, now);
	}
	if (wire[3] == 2) {
		return control(e, wire + 6, len - 10, now);
	}
	struct kr_profile peer;
	if (wire[3] != 1 || len < 52 ||
		!kr_profile_decode(&peer, wire + 14, len - 18)) {
		return kr_radio_error(e, source, wire, len, KR_BAD_DATA, now);
	}
	uint64_t peer_id = kr_get64(wire + 6);
	if (!peer_id || peer_id >> 63 || peer_id == e->config.device) {
		return KR_INVALID;
	}
	if (existing(e, peer_id) >= 0 || suppressed(e, peer_id)) {
		return KR_OK;
	}
	struct kr_record r = {0};
	r.kind = KR_MATCH;
	r.peer = peer_id;
	r.occurred_at = now;
	r.expires_at = now + e->config.profile.opportunity_sec;
	r.own = e->config.profile;
	r.peer_len = (uint16_t)len;
	memcpy(r.peer_wire, wire, len);
	return insert(e, &r);
}

size_t kr_advertisement(struct kr_engine *e, unsigned *cursor, uint8_t *out,
	int *sent_slot)
{
	*sent_slot = -1;
	if (!e->ready || e->storage_error) {
		return 0;
	}
	uint8_t body[KR_PROFILE_BYTES + 8];
	/* Round robin over profile + pending handshakes. No queue delay or score sorting. */
	for (unsigned n = 0; n <= KR_RECORDS + KR_SUPPRESSIONS; ++n) {
		unsigned index = (*cursor)++ % (KR_RECORDS + KR_SUPPRESSIONS + 1);
		if (index == 0) {
			kr_put64(body, e->config.device);
			size_t len = kr_profile_encode(&e->config.profile, body + 8);
			return kr_packet(1, body, len + 8, out);
		}
		if (index > KR_RECORDS) {
			const struct kr_suppression *s = &e->suppressed[index - KR_RECORDS - 1];
			if (!s->peer || (s->phase != KR_DONE && s->phase != KR_FINAL)) {
				continue;
			}
			kr_put64(body, e->config.device);
			kr_put64(body + 8, s->peer);
			memcpy(body + 16, s->id, 16);
			kr_put64(body + 32, s->occurred_at);
			kr_put64(body + 40, s->expires_at);
			kr_put64(body + 48, 0);
			kr_put32(body + 56, s->own_revision);
			kr_put32(body + 60, s->peer_revision);
			body[64] = s->phase;
			*sent_slot = s->phase == KR_FINAL ? (int)index - 1 : -1;
			return kr_packet(2, body, 65, out);
		}
		const struct kr_record *r = &e->records[index - 1];
		if (!r->kind || r->kind == KR_REVIEW || r->phase < KR_OFFER ||
			r->phase == KR_COMPLETE) {
			continue;
		}
		struct kr_profile peer;
		if (!kr_profile_decode(&peer, r->peer_wire + 14, r->peer_len - 18)) {
			continue;
		}
		kr_put64(body, e->config.device);
		kr_put64(body + 8, r->peer);
		memcpy(body + 16, r->id, 16);
		kr_put64(body + 32, r->occurred_at);
		kr_put64(body + 40, r->expires_at);
		kr_put64(body + 48, 0); /* Reserved; must stay zero in version 1. */
		kr_put32(body + 56, r->own.revision);
		kr_put32(body + 60, peer.revision);
		body[64] = r->phase;
		*sent_slot = r->phase == KR_FINAL ? (int)index - 1 : -1;
		return kr_packet(2, body, 65, out);
	}
	return 0;
}

void kr_sent(struct kr_engine *e, int slot)
{
	if (slot >= 0 && slot < KR_RECORDS && e->records[slot].phase == KR_FINAL) {
		struct kr_record r = e->records[slot];
		r.phase = KR_COMPLETE;
		(void)save(e, (unsigned)slot, &r);
	} else if (slot >= KR_RECORDS && slot < KR_RECORDS + KR_SUPPRESSIONS &&
		e->suppressed[slot - KR_RECORDS].phase == KR_FINAL) {
		struct kr_suppression s = e->suppressed[slot - KR_RECORDS];
		s.phase = KR_COMPLETE;
		(void)save_suppression(e, (unsigned)slot - KR_RECORDS, &s);
	}
}

enum kr_result kr_ack(struct kr_engine *e, const uint8_t id[16])
{
	int slot = -1;
	for (unsigned i = 0; i < KR_RECORDS; ++i) {
		if ((e->records[i].kind == KR_CONFIRMED || e->records[i].kind == KR_REVIEW) &&
			equal_id(e->records[i].id, id)) {
			slot = (int)i;
			break;
		}
	}
	int empty = -1;
	for (unsigned i = 0; i < KR_SUPPRESSIONS; ++i) {
		if (equal_id(e->suppressed[i].id, id) && e->suppressed[i].peer) {
			if (slot < 0) {
				return KR_OK;
			}
			empty = (int)i;
			break;
		}
		if (!e->suppressed[i].peer && empty < 0) {
			empty = (int)i;
		}
	}
	if (slot < 0) {
		return KR_NOT_FOUND;
	}
	if (empty < 0) {
		return KR_FULL;
	}
	const struct kr_record *r = &e->records[slot];
	struct kr_suppression s = {
		.peer = r->peer, .occurred_at = r->occurred_at, .expires_at = r->expires_at,
		.own_revision = r->own.revision, .phase = r->phase,
	};
	if (r->kind == KR_CONFIRMED) {
		struct kr_profile peer;
		if (!kr_profile_decode(&peer, r->peer_wire + 14, r->peer_len - 18)) {
			return KR_INVALID;
		}
		s.peer_revision = peer.revision;
	}
	memcpy(s.id, id, 16);
	/* Suppression first, raw deletion second; either crash ordering is safe. */
	if (save_suppression(e, (unsigned)empty, &s) != KR_OK) {
		return KR_STORAGE;
	}
	struct kr_record cleared = {0};
	return save(e, (unsigned)slot, &cleared);
}

enum kr_result kr_release(struct kr_engine *e, const uint8_t id[16])
{
	for (unsigned i = 0; i < KR_SUPPRESSIONS; ++i) {
		if (equal_id(e->suppressed[i].id, id) && e->suppressed[i].peer) {
			/* Never release while a failed raw deletion still needs recovery. */
			if (existing(e, e->suppressed[i].peer) >= 0) {
				return KR_CONFLICT;
			}
			if (e->suppressed[i].phase != KR_COMPLETE) {
				return KR_NOT_READY;
			}
			struct kr_suppression cleared = {0};
			if (e->io.suppression(e->io.ctx, i, &cleared)) {
				return KR_STORAGE;
			}
			e->suppressed[i] = cleared;
			return KR_OK;
		}
	}
	return KR_NOT_FOUND;
}
```

## src/phone.c
```c
#include "phone.h"
#include <string.h>

size_t kr_phone_frame(uint8_t op, uint32_t request, const uint8_t *body,
	size_t len, uint8_t *out)
{
	if (len > KR_FRAME_MAX - 14) {
		return 0;
	}
	out[0] = 'K';
	out[1] = 'P';
	out[2] = KR_VERSION;
	out[3] = op;
	kr_put32(out + 4, request);
	kr_put16(out + 8, (uint16_t)len);
	memmove(out + 10, body, len);
	kr_put32(out + 10 + len, kr_crc32(out, 10 + len));
	return len + 14;
}

static enum kr_result execute(struct kr_engine *e, uint8_t op, const uint8_t *p,
	size_t len, uint8_t *out, size_t *out_len, uint64_t *new_utc)
{
	*out_len = 0;
	if (op == KR_STATUS && len == 0) {
		kr_put64(out, e->config.device);
		out[8] = e->config.registered;
		out[9] = e->ready;
		kr_put32(out + 10, e->config.profile.revision);
		kr_put16(out + 14, (uint16_t)kr_count(e, KR_MATCH));
		kr_put16(out + 16, (uint16_t)kr_count(e, KR_CONFIRMED));
		kr_put16(out + 18, (uint16_t)kr_count(e, KR_REVIEW));
		kr_put16(out + 20, (uint16_t)kr_count(e, KR_EMPTY));
		kr_put32(out + 22, e->overflow);
		out[26] = e->storage_error;
		out[27] = 255; /* Battery is unmeasured, never a fabricated zero. */
		*out_len = 28;
		return KR_OK;
	}
	if (op == KR_REGISTER && len == 32) {
		return kr_register(e, p, p + 16);
	}
	if (len < 16 || !kr_auth(e, p)) {
		return KR_UNAUTHORIZED;
	}
	p += 16;
	len -= 16;
	if (op == KR_SYNC && len >= 42) {
		uint64_t utc = kr_get64(p);
		struct kr_profile profile;
		if (!utc || utc > INT64_MAX / 1000 || !kr_profile_decode(&profile, p + 8, len - 8)) {
			return KR_INVALID;
		}
		enum kr_result result = kr_sync(e, &profile);
		if (result == KR_OK) {
			*new_utc = utc;
			kr_put32(out, profile.revision);
			memcpy(out + 4, profile.snapshot, 16);
			*out_len = 20;
		}
		return result;
	}
	if (op == KR_READ_RECORD && len == 5 && (p[0] == KR_CONFIRMED || p[0] == KR_REVIEW)) {
		uint32_t after = kr_get32(p + 1);
		const struct kr_record *found = NULL;
		for (unsigned i = 0; i < KR_RECORDS; ++i) {
			const struct kr_record *r = &e->records[i];
			if (r->kind == p[0] && r->sequence > after &&
				(!found || r->sequence < found->sequence)) {
				found = r;
			}
		}
		if (!found) {
			return KR_NOT_FOUND;
		}
		*out_len = kr_record_encode(found, out);
		return KR_OK;
	}
	/* Lab-only receipt, not a production server signature. No ACK on READ. */
	if (op == KR_LAB_STORED_RECEIPT && len == 29 && kr_get64(p) == e->config.device && p[28] == 1) {
		for (unsigned i = 0; i < KR_RECORDS; ++i) {
			const struct kr_record *r = &e->records[i];
			if (r->kind && memcmp(r->id, p + 8, 16) == 0) {
				size_t n = kr_record_encode(r, out);
				if (kr_crc32(out, n) != kr_get32(p + 24)) {
					return KR_CONFLICT;
				}
				return kr_ack(e, p + 8);
			}
		}
		return kr_ack(e, p + 8); /* Idempotent receipt retry after deletion. */
	}
	if (op == KR_LAB_RELEASE && len == 16) {
		return kr_release(e, p);
	}
	return KR_INVALID;
}

size_t kr_phone_process(struct kr_engine *e, const uint8_t *in, size_t len,
	uint8_t *out, uint64_t *new_utc)
{
	*new_utc = 0;
	if (len < 14 || len > KR_FRAME_MAX || in[0] != 'K' || in[1] != 'P' ||
		in[2] != KR_VERSION || in[3] & 0x80 || (size_t)kr_get16(in + 8) + 14 != len ||
		kr_get32(in + len - 4) != kr_crc32(in, len - 4)) {
		return 0;
	}
	size_t payload_len = 0;
	enum kr_result result = execute(e, in[3], in + 10, len - 14,
		out + 11, &payload_len, new_utc);
	out[10] = (uint8_t)result;
	if (result != KR_OK) {
		payload_len = 0;
	}
	return kr_phone_frame(in[3] | 0x80, kr_get32(in + 4), out + 10, payload_len + 1, out);
}
```

## src/storage.c
```c
#include "storage.h"
#include <errno.h>
#include <zephyr/device.h>
#include <zephyr/fs/nvs.h>
#include <zephyr/storage/flash_map.h>

static struct nvs_fs fs;
static bool mounted;
BUILD_ASSERT(sizeof(struct kr_record) < 3900, "NVS record must fit one sector");
BUILD_ASSERT(CONFIG_NORDIC_QSPI_NOR_FLASH_LAYOUT_PAGE_SIZE == 4096,
	"QSPI page layout must match the 4 KiB NVS sector");

static int write_value(uint16_t id, const void *value, size_t len)
{
	if (!mounted) {
		return -EIO;
	}
	ssize_t written = nvs_write(&fs, id, value, len);
	/* nvs_write returns 0 for an already identical durable value. */
	return written == (ssize_t)len || written == 0 ? 0 : (int)written;
}

int kr_storage_config(void *ctx, const struct kr_config *config)
{
	ARG_UNUSED(ctx);
	return write_value(1, config, sizeof(*config));
}

int kr_storage_record(void *ctx, unsigned slot, const struct kr_record *record)
{
	ARG_UNUSED(ctx);
	if (slot >= KR_RECORDS || !mounted) {
		return -EINVAL;
	}
	if (record->kind == KR_EMPTY) {
		return nvs_delete(&fs, (uint16_t)(100 + slot));
	}
	return write_value((uint16_t)(100 + slot), record, sizeof(*record));
}

int kr_storage_suppression(void *ctx, unsigned slot, const struct kr_suppression *s)
{
	ARG_UNUSED(ctx);
	if (slot >= KR_SUPPRESSIONS || !mounted) {
		return -EINVAL;
	}
	if (!s->peer) {
		return nvs_delete(&fs, (uint16_t)(200 + slot));
	}
	return write_value((uint16_t)(200 + slot), s, sizeof(*s));
}

static int restore(uint16_t id, void *value, size_t len)
{
	ssize_t result = nvs_read(&fs, id, value, len);
	if (result == -ENOENT) {
		return 0;
	}
	return result == (ssize_t)len ? 0 : -EILSEQ;
}

int kr_storage_open(struct kr_engine *e)
{
	const struct device *flash = FIXED_PARTITION_DEVICE(keyring_store);
	int result = device_is_ready(flash) ? 0 : device_init(flash);
	if (result) {
		return result;
	}
	const struct flash_area *area;
	result = flash_area_open(FIXED_PARTITION_ID(keyring_store), &area);
	if (result) {
		return result;
	}
	fs.flash_device = area->fa_dev;
	fs.offset = area->fa_off;
	fs.sector_size = 4096;
	fs.sector_count = area->fa_size / fs.sector_size;
	result = nvs_mount(&fs);
	flash_area_close(area);
	if (result) {
		return result; /* Never automatically erase a failed/corrupt store. */
	}
	mounted = true;
	uint64_t hardware_id = e->config.device;
	result = restore(1, &e->config, sizeof(e->config));
	for (unsigned i = 0; !result && i < KR_RECORDS; ++i) {
		result = restore((uint16_t)(100 + i), &e->records[i], sizeof(e->records[i]));
	}
	for (unsigned i = 0; !result && i < KR_SUPPRESSIONS; ++i) {
		result = restore((uint16_t)(200 + i), &e->suppressed[i], sizeof(e->suppressed[i]));
	}
	if (!result && (hardware_id != e->config.device || !kr_restored_valid(e))) {
		result = -EILSEQ;
	}
	return result;
}
```
